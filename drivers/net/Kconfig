## drivers/net/Kconfig
```kconfig
# Kconfig - Misc network drivers configuration options
# SPDX-License-Identifier: Apache-2.0

#
# PPP options
#
menuconfig NET_PPP
	bool "Point-to-point (PPP) driver support"
	depends on NET_L2_PPP

if NET_PPP

config NET_PPP_UART
	bool "Enable PPP UART based driver"
	default y
	select UART_PIPE
	select UART_INTERRUPT_DRIVEN

config NET_PPP_DRV_NAME
	string "PPP Driver name"
	default "ppp"
	depends on NET_PPP_UART
	help
	  This option sets the driver name

config NET_PPP_UART_PIPE_BUF_LEN
	int "Buffer length when reading from UART"
	default 8
	help
	  This options sets the size of the UART pipe buffer where data
	  is being read to.

config NET_PPPOE
	bool "Enable PPP over Ethernet"
	depends on NET_L2_ETHERNET
	help
	  Support PPP over Ethernet links. This option will cause ppp
	  specific network interface to be created. All the packets sent
	  to it will be directed to real Ethernet network interface.

config NET_PPPOE_SERVICE_NAME
	string "Service name"
	default ""
	depends on NET_PPPOE
	help
	  This option sets the PPPoE service name that is set in Discovery
	  messages. This can be left empty which indicates that any service is
	  acceptable

config NET_PPPOE_DRV_NAME
	string "PPPoE Driver name"
	default "pppoe"
	depends on NET_PPPOE
	help
	  This option sets the PPPoE driver name

config	NET_PPPOE_ETH_DRV_NAME
	string "Name of the Ethernet device"
	depends on NET_PPPOE
	help
	  This setting binds PPP over this Ethernet device. If this is left
	  empty, then first Ethernet device is used instead.

config NET_PPPOE_DELAY_STARTUP_MS
	int "Delay in ms before sending 1st Discovery"
	default 0
	depends on NET_PPPOE
	help
	  Delay the sending of first PPPoE Discovery packet. This is useful in
	  debugging. The value is in milliseconds. Value 0 disables the wait.

config NET_PPPOE_MAX_WAIT_IN_DISCOVERY
	int "Max delay in sec between two Discovery packets"
	default 60
	depends on NET_PPPOE
	help
	  When we do not receive a PADO packet within a specified amount
	  of time, we will resend PADI packet and double the waiting
	  period. This value tells the maximum wait. The value is in seconds.

config NET_PPP_MTU
	int "PPP MTU"
	default 1500
	range 80 1500
	help
	  This option sets the MTU for the PPP connection.
	  The value is only used when fragmenting the network
	  data into net_buf's.

config NET_PPP_VERIFY_FCS
	bool "Verify that received FCS is valid"
	default y
	help
	  If you have a reliable link, then it might make sense
	  to disable this as it takes some time to verify the received
	  packet.

config NET_PPP_CALC_FCS
	bool "Calculate FCS for the sent packet"
	default y
	help
	  If you have a reliable link, then it might make sense
	  to disable this as it takes some time to calculate the FCS for
	  the sent packet.

config	PPP_MAC_ADDR
	string "MAC address for the interface"
	help
	  Specify a MAC address for the PPP interface in the form of
	  six hex 8-bit chars separated by colons (e.g.:
	  aa:33:cc:22:e2:c0).  The default is an empty string, which
	  means the code will make 00:00:5E:00:53:XX, where XX will be
	  random.

module = NET_PPP
module-dep = LOG
module-str = Log level for ppp driver
module-help = Sets log level for ppp driver.
source "subsys/net/Kconfig.template.log_config.net"

endif # NET_PPP

#
# SLIP options
#
menuconfig SLIP
	bool "SLIP driver"
	depends on (!QEMU_TARGET || NET_QEMU_SLIP)
	select UART_PIPE
	select UART_INTERRUPT_DRIVEN

if SLIP

config	SLIP_DRV_NAME
	string "SLIP Driver name"
	default "slip"
	help
	  This option sets the driver name

config	SLIP_MTU
	int "SLIP MTU"
	default 1500
	range 80 1500
	help
	  This option sets the MTU for the SLIP connection.
	  The value is only used when fragmenting the network
	  data into net_buf's. The actual SLIP connection
	  does not use this value.

module = SLIP
module-dep = LOG
module-str = Log level for slip driver
module-help = Sets log level for slip driver.
source "subsys/net/Kconfig.template.log_config.net"

config	SLIP_STATISTICS
	bool "SLIP network connection statistics"
	help
	  This option enables statistics support for SLIP driver.

config  SLIP_TAP
	bool "Use TAP interface to host"
	default y
	select NET_L2_ETHERNET
	help
	  In TAP the Ethernet frames are transferred over SLIP.


config	SLIP_MAC_ADDR
	string "MAC address for the interface"
	help
	  Specify a MAC address for the SLIP interface in the form of
	  six hex 8-bit chars separated by colons (e.g.:
	  aa:33:cc:22:e2:c0).  The default is an empty string, which
	  means the code will make 00:00:5E:00:53:XX, where XX will be
	  random.

endif

#
# Net loopback options
#
menuconfig NET_LOOPBACK
	bool "Net loopback driver"
	select NET_L2_DUMMY

if NET_LOOPBACK

module = NET_LOOPBACK
module-dep = LOG
module-str = Log level for network loopback driver
module-help = Sets log level for network loopback driver.
source "subsys/net/Kconfig.template.log_config.net"

endif
```

## modules/hostap/Kconfig
```kconfig
# Copyright (c) 2023 Nordic Semiconductor ASA
# SPDX-License-Identifier: Apache-2.0

# This option selects needed options
config WIFI_SUPPLICANT_USE_HOSTAP
       bool
       default y
	# Need full POSIX from libc, Zephyr's POSIX support is only partial
	depends on !POSIX_API && WIFI_SUPPLICANT_HOSTAP
	select POSIX_CLOCK
	select NET_SOCKETS
	select NET_SOCKETS_PACKET
	select NET_SOCKETPAIR
	select WIFI_NM
	select NET_INTERFACE_NAME
	help
	  WPA supplicant implements 802.1X related functions.

if WIFI_SUPPLICANT_HOSTAP

choice LIBC_IMPLEMENTATION
	default NEWLIB_LIBC
endchoice

config WIFI_SUPPLICANT_HOSTAP_THREAD_STACK_SIZE
	int "Stack size for wpa_supplicant thread"
	default 8192

config WIFI_SUPPLICANT_HOSTAP_WQ_STACK_SIZE
	int "Stack size for network interface workqueue"
	default 4096

config WIFI_SUPPLICANT_HOSTAP_WQ_PRIO
	int "Priority of the network interface work queue"
	default 7
	help
	  Set the priority of the the network interface worker queue.

config WEP
	bool "WEP (Legacy crypto) support"

# To easily manage the crypto dependencies we separate the crypto
# implementations into two Kconfig options. One for the legacy crypto
# and one for the PSA crypto.
config WIFI_SUPPLICANT_HOSTAP_CRYPTO_PSA
	bool "PSA Crypto support for WiFi"
	select WEP
	select PSA_WANT_KEY_TYPE_AES
	select PSA_WANT_ALG_CMAC
	select PSA_WANT_ALG_CBC_PKCS7
	select PSA_WANT_ALG_CTR
	select PSA_WANT_ALG_ECDSA
	select PSA_WANT_GENERATE_RANDOM
	select PSA_WANT_ALG_RSA_PSS
	select PSA_WANT_ALG_DETERMINISTIC_ECDSA
	select PSA_WANT_ALG_SHA_512
	select PSA_WANT_ALG_SHA_1
	select PSA_WANT_KEY_TYPE_RSA_KEY_PAIR
	select PSA_WANT_ECC_SECP_R1_256
	# Legacy crypto, still needed
	select MBEDTLS_CMAC_C
	select MBEDTLS_GCM_C
	select MBEDTLS_TLS_LIBRARY
	select MBEDTLS_PK_WRITE_C
	select MBEDTLS_X509_LIBRARY
	select MBEDTLS_X509_CRT_PARSE_C
	select MBEDTLS_CIPHER_C
	select MBEDTLS_CIPHER_MODE_CTR
	select MBEDTLS_CIPHER_MODE_CBC
	select MBEDTLS_SSL_TLS_C
	select MBEDTLS_KEY_EXCHANGE_ALL_ENABLED
	default y if BUILD_WITH_TFM

config WIFI_SUPPLICANT_HOSTAP_CRYPTO
	bool "Legacy Crypto support for WiFi"
	select WEP
	select MBEDTLS
	select NRF_SECURITY
	select MBEDTLS_CIPHER_MODE_CBC
	select MBEDTLS_CIPHER_MODE_CTR
	select MBEDTLS_LEGACY_CRYPTO_C
	select MBEDTLS_ECP_C
	select MBEDTLS_CTR_DRBG_C
	select MBEDTLS_PK_WRITE_C
	select MBEDTLS_KEY_EXCHANGE_ALL_ENABLED
	default y if !BUILD_WITH_TFM

# To fix MAC_MD5 Kconfig warning
config NET_TCP_ISN_RFC6528
	default n if WIFI_SUPPLICANT_HOSTAP_CRYPTO

config WIFI_SUPPLICANT_HOSTAP_CRYPTO_ENTERPRISE
	bool "Enterprise Crypto support for WiFi"

config WIFI_SUPPLICANT_HOSTAP_WPA3
	bool "WPA3 support"
	select WIFI_SUPPLICANT_HOSTAP_CRYPTO
	default y

config WIFI_SUPPLICANT_HOSTAP_AP
	bool "AP mode support"
	select WIFI_SUPPLICANT_HOSTAP_CRYPTO

config WIFI_SUPPLICANT_HOSTAP_WPS
	bool "WPS support"

config WIFI_SUPPLICANT_HOSTAP_P2P
	bool "P2P mode support"
	select WIFI_SUPPLICANT_HOSTAP_AP
	select WIFI_SUPPLICANT_HOSTAP_WPS

config WIFI_SUPPLICANT_HOSTAP_EAPOL
	bool "Enable EAPoL supplicant"

config WIFI_SUPPLICANT_HOSTAP_CLI
	bool "CLI support for wpa_supplicant"
	default n

config NET_SOCKETPAIR_BUFFER_SIZE
	default 4096

config POSIX_MAX_FDS
	# l2_packet - 1
	# ctrl_iface - 2 * socketpairs = 4(local and global)
	# z_wpa_event_sock - 1 socketpair = 2
	# Remaining left for the applications running in default configuration
	default 16 if !POSIX_API

config WIFI_BSS_MAX_IDLE_TIME
	int "BSS max idle timeout in seconds"
	range 0 64000
	default 300
	help
	  BSS max idle timeout is the period for which AP may keep a client
	  in associated state while there is no traffic from that particular
	  client. Set 0 to disable inclusion of BSS max idle time tag in
	  association request. If a non-zero value is set, STA can suggest a
	  timeout by including BSS max idle period in the association request.
	  AP may choose to consider or ignore the STA's preferred value.
	  Ref: Sec 11.21.13 of IEEE Std 802.11™-2020

# Control interface is stack heavy (buffers + snprintfs)
config NET_MGMT_EVENT_STACK_SIZE
	default 4096

config NET_SOCKETS_POLL_MAX
	default 4

module = WIFI_SUPPLICANT_HOSTAP
module-str = WPA supplicant
source "subsys/logging/Kconfig.template.log_config"

config WIFI_SUPPLICANT_HOSTAP_DEBUG_LEVEL
	int "Min compiled-in debug message level for WPA supplicant"
	default 0 if WIFI_SUPPLICANT_HOSTAP_LOG_LEVEL_DBG # MSG_EXCESSIVE
	default 3 if WIFI_SUPPLICANT_HOSTAP_LOG_LEVEL_INF # MSG_INFO
	default 4 if WIFI_SUPPLICANT_HOSTAP_LOG_LEVEL_WRN # MSG_WARNING
	default 5 if WIFI_SUPPLICANT_HOSTAP_LOG_LEVEL_ERR # MSG_ERROR
	default 6
	help
	  Minimum priority level of a debug message emitted by WPA supplicant that
	  is compiled-in the firmware. See wpa_debug.h file of the supplicant for
	  available levels and functions for emitting the messages. Note that
	  runtime filtering can also be configured in addition to the compile-time
	  filtering.

config WIFI_SUPPLICANT_HOSTAP_NO_DEBUG
	bool "Disable printing of debug messages, saves code size significantly"

endif # WIFI_SUPPLICANT_HOSTAP
```

## samples/net/gptp/boards/frdm_k64f.conf
```kconfig
# MCUX driver settings
CONFIG_ETH_MCUX=y
CONFIG_PTP_CLOCK_MCUX=y

# Optionally you can use fixed MAC address
CONFIG_ETH_MCUX_0_RANDOM_MAC=n
CONFIG_ETH_MCUX_0_MAC3=0xBC
CONFIG_ETH_MCUX_0_MAC4=0x8C
CONFIG_ETH_MCUX_0_MAC5=0xAE
```

## samples/net/sockets/http_client/sample.yaml
```yaml
common:
  tags: net http http_client
sample:
  description: HTTP client sample
  name: http_client
tests:
  sample.net.sockets.http_client:
    harness: net
```

## samples/net/sockets/http_server/sample.yaml
```yaml
sample:
  description: HTTP Server Sample
  name: http_server_sample
common:
  filter: TOOLCHAIN_HAS_NEWLIB == 1
  harness: net
  min_ram: 192
  tags:
    - http
    - net
    - server
    - socket
  platform_exclude:
    - native_posix
    - native_posix/native/64
tests:
  sample.net.sockets.http.server: {}
```

## samples/net/stats/sample.yaml
```yaml
common:
  tags: net statistics
sample:
  description: Test network statistics functionality
  name: Network statistics sample app
tests:
  test:
    min_ram: 64
```

## subsys/net/lib/rpcap/Kconfig
```kconfig
# Options for packet capturing

# Copyright (c) 2020 Intel Corporation.
# SPDX-License-Identifier: Apache-2.0

menuconfig NET_RPCAP
	bool "Enable remote packet capturing (RPCAP) support [EXPERIMENTAL]"
	select NET_TCP
	help
	  This setting enables the rpcap support at built time,
	  it is still necessary to start capturing the packets at runtime.
	  This can be done by enabling RPCAPD functionality running in Zephyr
	  and RPCAP client like dumpcap running in remote host.

if NET_RPCAP

module = NET_RPCAP
module-dep = NET_LOG
module-str = Log level for PCAP library
module-help = Enables net PCAP library to output debug messages.
source "subsys/net/Kconfig.template.log_config.net"

source "subsys/net/lib/rpcap/Kconfig.rpcapd"

endif # NET_RPCAP
```

## subsys/net/lib/rpcap/Kconfig.rpcapd
```kconfig
# Options for packet capturing

# Copyright (c) 2020 Intel Corporation.
# SPDX-License-Identifier: Apache-2.0

menuconfig NET_RPCAPD
	bool "Enable RPCAP daemon [EXPERIMENTAL]"
	select NET_SOCKETS
	help
	  If this option is set, then the remote PCAP server (rpcapd)
	  functionality is enabled. This daemon support is provided as a simple
	  way to capture network traffic from one network interface.
	  If you need to capture from more than one network interface, you
	  need to create your own rpcapd implementation.

if NET_RPCAPD

choice
	prompt "RPCAP daemon mode"
	default NET_RPCAPD_MODE_PASSIVE
	help
	  Passive or active mode. In passive mode, Zephyr starts to wait
	  connection from RPCAP client. In active mode, Zephyr will connect
	  itself to RPCAP client.

config NET_RPCAPD_MODE_PASSIVE
	bool "Passive"
	help
	  Wait connection attempt from RPCAP client.

config NET_RPCAPD_MODE_ACTIVE
	bool "Active"
	help
	  Connect to RPCAP client.

endchoice

config NET_RPCAPD_LISTENING_PORT
	int "Listening TCP port number"
	default 2002
	range 1 65535
	depends on NET_RPCAPD_MODE_PASSIVE
	help
	  Default port for listening connections is 2002.

config NET_RPCAPD_CONNECTION_FROM
	string "Allow connection from this host"
	default ""
	depends on NET_RPCAPD_MODE_PASSIVE
	help
	  If left empty, then allow connection from any host.
	  Set here IPv4 or IPv6 address to restrict access from
	  certain host.

config NET_RPCAPD_ENABLE_LLMNR_RESPONDER
	bool "Allow client to find us using hostname"
	default y
	depends on NET_RPCAPD_MODE_PASSIVE
	select NET_HOSTNAME_ENABLE
	select LLMNR_RESPONDER
	help
	  Allow client node to connect Zephyr using a name instead
	  of IP address. The system will enable LLMNR support for this.
	  Note that you must set the hostname of this device.

config NET_RPCAPD_CONNECTING_PORT
	int "Connecting TCP port number"
	default 2003
	range 1 65535
	depends on NET_RPCAPD_MODE_ACTIVE
	help
	  Default port for connecting to peer is 2003.

config NET_RPCAPD_REMOTE_HOST
	string "Host where to send the captured packets"
	default ""
	depends on NET_RPCAPD_MODE_ACTIVE
	help
	  The host should be running rpcapd daemon which will receive
	  the packets and can store them. Default port is 2002 if user
	  has not specified any. The host must be in numeric form, hostname
	  is not resolved via DNS.
	  Following syntax is supported:
	  192.0.2.1
	  192.0.2.1:2002
	  2001:db8::1
	  [2001:db8::1]:2002

config NET_RPCAPD_HANDLER_STACK_SIZE
	int "Handler thread stack size"
	default 1024
	help
	  Size of the handler thread stack.

config NET_RPCAPD_RX
	bool "Enable RX capturing"
	default y

config NET_RPCAPD_TX
	bool "Enable TX capturing"
	default y

config NET_RPCAPD_PKT_RX_COUNT
	int "How many packet receives can be pending at the same time"
	default NET_PKT_RX_COUNT
	help
	  Each RX buffer will occupy smallish amount of memory.
	  See include/net/net_pkt.h and the sizeof(struct net_pkt)

config NET_RPCAPD_PKT_TX_COUNT
	int "How many packet sends can be pending at the same time"
	default NET_PKT_TX_COUNT
	help
	  Each TX buffer will occupy smallish amount of memory.
	  See include/net/net_pkt.h and the sizeof(struct net_pkt)

config NET_RPCAPD_BUF_RX_COUNT
	int "How many network buffers are allocated for receiving data"
	default NET_BUF_RX_COUNT
	help
	  Each data buffer will occupy CONFIG_NET_BUF_DATA_SIZE + smallish
	  header (sizeof(struct net_buf)) amount of data.

config NET_RPCAPD_BUF_TX_COUNT
	int "How many network buffers are allocated for sending data"
	default NET_BUF_TX_COUNT
	help
	  Each data buffer will occupy CONFIG_NET_BUF_DATA_SIZE + smallish
	  header (sizeof(struct net_buf)) amount of data.

config NET_RPCAPD_BUF_DATA_SIZE
	int "Size of each network data fragment"
	default NET_BUF_DATA_SIZE
	help
	  This value tells what is the fixed size of each network buffer.
	  Normally you should not change this.

endif # NET_RPCAPD
```
