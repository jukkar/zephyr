## sample.yaml
```
common:
  harness: net
  tags: net pcap rpcap
sample:
  description: Sample for capturing network packets
  name: rpcap daemon
tests:
  sample.net.rpcapd:
    depends_on: netif
```

## prj.conf
```kconfig
CONFIG_NETWORKING=y
CONFIG_NET_IPV4=y
CONFIG_NET_IPV6=y
CONFIG_NET_DHCPV4=y
CONFIG_NET_RPCAP=y
CONFIG_NET_RPCAPD=y

# Network application options and configuration
CONFIG_NET_CONFIG_SETTINGS=y
CONFIG_NET_CONFIG_MY_IPV6_ADDR="2001:db8::1"
CONFIG_NET_CONFIG_PEER_IPV6_ADDR="2001:db8::2"
CONFIG_NET_CONFIG_MY_IPV4_ADDR="192.0.2.1"
CONFIG_NET_CONFIG_PEER_IPV4_ADDR="192.0.2.2"

# Log buffers, modem and PPP
CONFIG_LOG=y
CONFIG_NET_LOG=y
#CONFIG_LOG_BUFFER_SIZE=16384
#CONFIG_LOG_STRDUP_BUF_COUNT=200
#CONFIG_NET_RPCAP_LOG_LEVEL_DBG=y

CONFIG_NET_SHELL=y
```

## src/main.c
```c
/*
 * Copyright (c) 2020, Intel Corporation
 *
 * SPDX-License-Identifier: Apache-2.0
 */

#include <logging/log.h>
LOG_MODULE_REGISTER(rpcapd, LOG_LEVEL_DBG);

#include <zephyr.h>
#include <net/rpcapd.h>

int main(void)
{
	LOG_INF("Starting rpcap daemon");

	zrpcapd_init();

	return 0;
}
```
