## sample.yaml
```
sample:
    name: RPL Border Router
tests:
-   test:
        build_only: true
        # There are few platforms that does not fit in RAM
        platform_exclude: frdm_kw41z quark_se_c1000_devboard
        depends_on: ieee802154
        extra_args: CONF_FILE="prj.conf"
        tags: net rpl
```

## prj.conf
```kconfig
# Note that this configuration file does not provide usable system.
# It is only used to verify the compilation of the application.

# Generic IP stack options and features
CONFIG_NETWORKING=y
CONFIG_NET_TCP=y
CONFIG_NET_UDP=y
CONFIG_RANDOM_GENERATOR=y
CONFIG_TEST_RANDOM_GENERATOR=y
CONFIG_NET_LOG=y
CONFIG_INIT_STACKS=y
CONFIG_NET_SHELL=y
CONFIG_NET_STATISTICS=y
CONFIG_NET_MAX_CONTEXTS=8
CONFIG_NET_IPV6=y
CONFIG_NET_IPV4=y
#CONFIG_NET_DHCPV4=y

# Number of network buffers
CONFIG_NET_PKT_RX_COUNT=128
CONFIG_NET_PKT_TX_COUNT=128
CONFIG_NET_BUF_RX_COUNT=128
CONFIG_NET_BUF_TX_COUNT=128

# IPv6 address counts
CONFIG_NET_IF_UNICAST_IPV6_ADDR_COUNT=4
CONFIG_NET_IF_MCAST_IPV6_ADDR_COUNT=5

# IPv6 neighbors/routes count
CONFIG_NET_IPV6_MAX_NEIGHBORS=8

# RPL and routing options
CONFIG_NET_RPL=y
CONFIG_NET_ROUTE=y
CONFIG_NET_ROUTING=y
# This is used as a prefix when creating DAG.
CONFIG_NET_RPL_PREFIX="fd77:d528:ae6a:6df6::1/64"

# HTTP(S) admin interface
CONFIG_HTTP=y
CONFIG_HTTPS=n
CONFIG_HTTP_APP=y
CONFIG_NET_APP_SERVER=y
CONFIG_HTTP_SERVER=y
# Firefox sends lot of fields to this needs to be quite large
CONFIG_HTTP_HEADERS=20
CONFIG_HTTP_SERVER_NUM_URLS=8
CONFIG_WEBSOCKET=y

# Crypto support
CONFIG_MBEDTLS=y
CONFIG_MBEDTLS_BUILTIN=y
CONFIG_MBEDTLS_CFG_FILE="config-mini-tls1_2.h"
CONFIG_MBEDTLS_ENABLE_HEAP=y
CONFIG_MBEDTLS_HEAP_SIZE=30000

# Logging
CONFIG_SYS_LOG_SHOW_COLOR=y
CONFIG_SYS_LOG_NET_LEVEL=1

# Debugging
CONFIG_NET_DEBUG_WEBSOCKET=y
CONFIG_NET_DEBUG_HTTP=y
CONFIG_NET_DEBUG_HTTP_CONN=y
CONFIG_NET_DEBUG_RPL=y
CONFIG_NET_DEBUG_ROUTE=y

# Network application settings
CONFIG_NET_APP_SETTINGS=y
CONFIG_NET_APP_NEED_IPV6=y
CONFIG_NET_APP_NEED_IPV4=y
# This is the ethernet interface setting for admin purposes
CONFIG_NET_APP_MY_IPV6_ADDR="2001:db8::1"
CONFIG_NET_APP_MY_IPV4_ADDR="192.0.2.1"
```

## prj_frdm_k64f_cc2520.conf
```kconfig
# Generic IP stack options and features
CONFIG_NETWORKING=y
CONFIG_NET_TCP=y
CONFIG_NET_UDP=y
CONFIG_RANDOM_GENERATOR=y
CONFIG_TEST_RANDOM_GENERATOR=y
CONFIG_NET_LOG=y
CONFIG_INIT_STACKS=y
CONFIG_NET_SHELL=y
CONFIG_NET_STATISTICS=y
CONFIG_NET_MAX_CONTEXTS=16
CONFIG_NET_IPV6=y
CONFIG_NET_IPV4=y
#CONFIG_NET_DHCPV4=y

# Number of network buffers
CONFIG_NET_PKT_RX_COUNT=128
CONFIG_NET_PKT_TX_COUNT=128
CONFIG_NET_BUF_RX_COUNT=128
CONFIG_NET_BUF_TX_COUNT=128

# IPv6 address counts
CONFIG_NET_IF_UNICAST_IPV6_ADDR_COUNT=4
CONFIG_NET_IF_MCAST_IPV6_ADDR_COUNT=5

# IPv6 neighbors/routes count. This determines how many nodes
# our RPL network can have.
CONFIG_NET_IPV6_MAX_NEIGHBORS=128

# RPL and routing options
CONFIG_NET_RPL=y
CONFIG_NET_ROUTE=y
CONFIG_NET_ROUTING=y
CONFIG_NET_RPL_L2_IEEE802154=y
# This is used as a prefix when creating DAG.
CONFIG_NET_RPL_PREFIX="fde3:2cda:3eea:4d14::1/64"

# HTTP(S) admin and websocket interface support
CONFIG_HTTP=y
CONFIG_HTTPS=y
CONFIG_HTTP_APP=y
CONFIG_NET_APP_SERVER=y
CONFIG_HTTP_SERVER=y
# Firefox sends lot of fields to this needs to be quite large
CONFIG_HTTP_HEADERS=20
CONFIG_HTTP_SERVER_NUM_URLS=8
CONFIG_WEBSOCKET=y

# Allow two concurrent incoming connections
CONFIG_NET_TCP_BACKLOG_SIZE=2
CONFIG_NET_APP_SERVER_NUM_CONN=2

# Crypto support
CONFIG_MBEDTLS=y
CONFIG_MBEDTLS_BUILTIN=y
CONFIG_MBEDTLS_CFG_FILE="config-mini-tls1_2.h"
CONFIG_MBEDTLS_ENABLE_HEAP=y
CONFIG_MBEDTLS_HEAP_SIZE=12000

# Logging
CONFIG_SYS_LOG_SHOW_COLOR=y
CONFIG_SYS_LOG_NET_LEVEL=4
CONFIG_SYS_LOG_IEEE802154_DRIVER_LEVEL=0

# Debugging
CONFIG_NET_DEBUG_NET_PKT=y
CONFIG_NET_DEBUG_WEBSOCKET=y
CONFIG_NET_DEBUG_RPL=n
CONFIG_NET_DEBUG_ROUTE=n
CONFIG_NET_DEBUG_APP=y
CONFIG_NET_DEBUG_IPV6=n
CONFIG_NET_DEBUG_IPV6_NBR_CACHE=n
CONFIG_NET_DEBUG_CONTEXT=n
CONFIG_NET_DEBUG_TCP=n
CONFIG_NET_DEBUG_CONN=n
CONFIG_NET_DEBUG_HTTP=y
CONFIG_MBEDTLS_DEBUG=n

# Network application settings
CONFIG_NET_APP_SETTINGS=y
CONFIG_NET_APP_NEED_IPV6=y
CONFIG_NET_APP_NEED_IPV4=y
# This is the ethernet interface setting for admin purposes
CONFIG_NET_APP_MY_IPV6_ADDR="2001:db8::1"
CONFIG_NET_APP_MY_IPV4_ADDR="192.0.2.1"

# IEEE 802.15.4 options
CONFIG_NET_L2_IEEE802154_SHELL=y
CONFIG_NET_L2_IEEE802154=y
CONFIG_NET_L2_IEEE802154_FRAGMENT=y
CONFIG_NET_APP_IEEE802154_CHANNEL=15
CONFIG_NET_APP_IEEE802154_DEV_NAME="cc2520"
CONFIG_IEEE802154_CC2520=y

# IPv6 compression is needed for IEEE 802.15.4
CONFIG_NET_6LO=y
CONFIG_NET_6LO_CONTEXT=y

# CC2520 options
CONFIG_IEEE802154_CC2520_AUTO_ACK=y
CONFIG_IEEE802154_CC2520_SPI_DRV_NAME="SPI_0"
CONFIG_IEEE802154_CC2520_SPI_FREQ=4000000
CONFIG_IEEE802154_CC2520_SPI_SLAVE=0
CONFIG_GPIO=y
CONFIG_SPI=y
CONFIG_SPI_0=y
```

## src/rpl.c
```c
/*
 * Copyright (c) 2017 Intel Corporation
 *
 * SPDX-License-Identifier: Apache-2.0
 */

#if 1
#define SYS_LOG_DOMAIN "rpl-br/rpl"
#define NET_SYS_LOG_LEVEL SYS_LOG_LEVEL_DEBUG
#define NET_LOG_ENABLED 1
#endif

#include <zephyr.h>
#include <stdio.h>
#include <stdlib.h>

#include <net/net_ip.h>
#include "rpl.h"

#include "config.h"

static struct {
	struct in6_addr dag_id;
	u8_t dag_init_version;
	bool dag_has_version;

	struct in6_addr prefix;
	u8_t prefix_len;
} rpl;

static bool br_join_dag(struct net_rpl_dio *dio)
{
	static u8_t last_version;

	if (net_ipv6_addr_cmp(&dio->dag_id, &rpl.dag_id)) {
		if (rpl.dag_init_version != dio->version &&
		    last_version != dio->version) {
			NET_DBG("Me root, DIO version %d instance %d",
				dio->version, dio->instance_id);
			last_version = dio->version;
		}

		if (dio->version > NET_RPL_LOLLIPOP_CIRCULAR_REGION) {
			rpl.dag_init_version = dio->version;
			rpl.dag_has_version = true;
		}
#if CONFIG_SYS_LOG_NET_LEVEL > 3
	} else {
		char me[NET_IPV6_ADDR_LEN];
		char other[NET_IPV6_ADDR_LEN];

		net_addr_ntop(AF_INET6, &dio->dag_id, other,
			      NET_IPV6_ADDR_LEN);
		net_addr_ntop(AF_INET6, &rpl.dag_id, me, NET_IPV6_ADDR_LEN);

		NET_DBG("Other root %s, me %s, DIO version %d instance %d",
			other, me, dio->version, dio->instance_id);
#endif
	}

	return 0;
}

bool setup_rpl(struct net_if *iface, const char *addr_prefix)
{
	char prefix[NET_IPV6_ADDR_LEN + 1];
	struct net_rpl_dag *dag;
	char *slash;
	bool ret;

	/* As the addr_prefix is Kconfig option we need to copy it to temporary
	 * buffer in order to be able to manipulate it.
	 */
	memset(prefix, 0, sizeof(prefix));
	memcpy(prefix, addr_prefix, min(strlen(addr_prefix),
					NET_IPV6_ADDR_LEN));

	slash = strstr(prefix, "/");
	if (!slash) {
		rpl.prefix_len = 64;
	} else {
		*slash = '\0';
		rpl.prefix_len = atoi(slash + 1);
	}

	if (rpl.prefix_len == 0) {
		NET_ERR("Invalid prefix length %s", slash + 1);
		return false;
	}

	if (net_addr_pton(AF_INET6, prefix, &rpl.prefix) < 0) {
		NET_ERR("Invalid IPv6 prefix %s", prefix);
		return false;
	}

	net_rpl_set_join_callback(br_join_dag);

	if (rpl.dag_has_version) {
		net_rpl_lollipop_increment(&rpl.dag_init_version);

		dag = net_rpl_set_root_with_version(iface,
			CONFIG_NET_RPL_DEFAULT_INSTANCE, &rpl.dag_id,
			rpl.dag_init_version);
	} else {
		dag = net_rpl_set_root(iface, CONFIG_NET_RPL_DEFAULT_INSTANCE,
				       &rpl.prefix);
	}
	if (!dag) {
		NET_ERR("Cannot set root node");
		return false;
	}

	net_rpl_dag_set_grounded_status(dag, 1);

	ret = net_rpl_set_prefix(iface, dag, &rpl.prefix, rpl.prefix_len);
	if (!ret) {
		NET_ERR("Cannot set prefix %s/%d", prefix, rpl.prefix_len);
		return false;
	}

#if CONFIG_SYS_LOG_NET_LEVEL > 3
	{
		char out[NET_IPV6_ADDR_LEN];

		if (net_addr_ntop(AF_INET6, &rpl.prefix, out,
				  NET_IPV6_ADDR_LEN)) {
			if (rpl.dag_has_version) {
				NET_DBG("New RPL dag %s/%d version %u created",
					out, rpl.prefix_len,
					rpl.dag_init_version);
			} else {
				NET_DBG("New RPL dag %s/%d created", out,
					rpl.prefix_len);
			}
		}
	}
#endif

	return true;
}
```

## src/shell.c
```c
/*
 * Copyright (c) 2017 Intel Corporation
 *
 * SPDX-License-Identifier: Apache-2.0
 */

#if 1
#define SYS_LOG_DOMAIN "rpl-br/shell"
#define NET_SYS_LOG_LEVEL SYS_LOG_LEVEL_DEBUG
#define NET_LOG_ENABLED 1
#endif

#include <zephyr.h>
#include <shell/shell.h>
#include <stdio.h>

#include "rpl.h"

#include "config.h"

#define BR_SHELL_MODULE "br"

int br_repair(int argc, char *argv[])
{
	ARG_UNUSED(argc);
	ARG_UNUSED(argv);

	NET_INFO("Starting global repair...");

	net_rpl_repair_root(CONFIG_NET_RPL_DEFAULT_INSTANCE);

	return 0;
}

static struct shell_cmd br_commands[] = {
	/* Keep the commands in alphabetical order */
	{ "repair", br_repair,
		"\n\tGlobal repair RPL network" },
	{ NULL, NULL, NULL }
};

SHELL_REGISTER(BR_SHELL_MODULE, br_commands);
```
