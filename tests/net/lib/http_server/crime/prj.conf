## CMakeLists.txt
```
# SPDX-License-Identifier: Apache-2.0

cmake_minimum_required(VERSION 3.20.0)
find_package(Zephyr REQUIRED HINTS $ENV{ZEPHYR_BASE})
project(crime)

set(gen_dir ${ZEPHYR_BINARY_DIR}/include/generated/http_server)
include(${ZEPHYR_BASE}/subsys/net/lib/http/server/crime.cmake)

set(app_sources)

# tests are in main.c
list(APPEND app_sources src/main.c)

# Note: all resources defined in the .c files below have static linkage and are therefore *not*
# visible to the testsuite via C identifier.

# Automatically generate a .c file for service_A resources
#
# This is intended to be the primary means by which users define compresses resources at build
# time as it scales well and requires the least amount of work by users.
zephyr_iterable_section(NAME http_resource_desc_service_A KVMA RAM_REGION GROUP RODATA_REGION SUBALIGN 4)
http_server_generate_crime_res(service_A app ${CMAKE_CURRENT_LIST_DIR}/src/service_A)

# Manually create a .c file for service_B resources
#
# This approach could be used for small designs with one or two compressed resources. Manually
# creating compressed resources involves significantly more work than using the automatic method
# above.
# 
# - index.html
#   - compressed manually with gzip
#   - converted manually to C array with xxd
# - js/service-B.js
#   - compressed and converted to C array with generate_inc_file_for_target()
list(APPEND app_sources src/service_B.c)
generate_inc_file_for_target(app ${CMAKE_CURRENT_LIST_DIR}/src/service_B/js/service-B.js ${gen_dir}/service_B/js/service-B.js.inc)
zephyr_linker_sources(SECTIONS src/service-B-rom-sections.ld)
zephyr_iterable_section(NAME http_resource_desc_service_B KVMA RAM_REGION GROUP RODATA_REGION SUBALIGN 4)

target_sources(app PRIVATE ${app_sources})
```

## Kconfig
```
source "Kconfig.zephyr"

config TEST_SERVER_ADDR
    string "Test HTTP Server address"
    default "127.0.0.1"

config TEST_SERVER_PROTO
    string "Test HTTP Server protocol"
    default "HTTP/1.1"

config TEST_SERVER_A_PORT
    int "Test HTTP Server port (service A)"
    default 4242

config TEST_SERVER_B_PORT
    int "Test HTTP Server port (service B)"
    default 7373

config TEST_BUF_SIZE
    int "Test HTTP receive buffer size (in bytes)"
    default 1024

config TEST_REQ_TIMEOUT
    int "Test HTTP request timeout (in milliseconds)"
    default 1000
```

## prj.conf
```kconfig
CONFIG_ZTEST=y
CONFIG_NET_TEST=y

# Eventfd
CONFIG_EVENTFD=y

CONFIG_ENTROPY_GENERATOR=y
CONFIG_TEST_RANDOM_GENERATOR=y
CONFIG_ZTEST_STACK_SIZE=1024

CONFIG_POSIX_MAX_FDS=10
CONFIG_REQUIRES_FULL_LIBC=y
CONFIG_EVENTFD_MAX=10
CONFIG_NET_MAX_CONTEXTS=10
CONFIG_NET_MAX_CONN=10

# Networking config
CONFIG_NETWORKING=y
CONFIG_NET_IPV4=y
CONFIG_NET_IPV6=y
CONFIG_NET_TCP=y
CONFIG_NET_SOCKETS=y
CONFIG_NET_LOOPBACK=y
CONFIG_NET_LOOPBACK_MTU=1280
CONFIG_NET_DRIVERS=y
CONFIG_NET_SOCKETS_POLL_MAX=8
CONFIG_NET_BUF_RX_COUNT=32
CONFIG_NET_BUF_TX_COUNT=32
CONFIG_NET_PKT_RX_COUNT=16
CONFIG_NET_PKT_TX_COUNT=16

# Reduce the retry count, so the close always finishes within a second
CONFIG_NET_TCP_RETRY_COUNT=3
CONFIG_NET_TCP_INIT_RETRANSMISSION_TIMEOUT=120

# JSON
CONFIG_JSON_LIBRARY=y

# HTTP parser
CONFIG_HTTP_PARSER_URL=y
CONFIG_HTTP_PARSER=y
CONFIG_HTTP_SERVER=y

CONFIG_HTTP_SERVER_MAX_CLIENTS=5
CONFIG_HTTP_SERVER_MAX_STREAMS=5

# Network address config
CONFIG_NET_CONFIG_SETTINGS=n

CONFIG_MAIN_STACK_SIZE=2048

# Network debug config
CONFIG_NET_LOG=y
```

## src/main.c
```c
/*
 * Copyright (c) 2023, Emna Rekik
 *
 * SPDX-License-Identifier: Apache-2.0
 */

#include "server_internal.h"

#include <string.h>

#include <zephyr/net/http/service.h>
#include <zephyr/net/socket.h>
#include <zephyr/ztest.h>

#define BUFFER_SIZE  256
#define STACK_SIZE   8192
#define MY_IPV4_ADDR "127.0.0.1"
#define SERVER_PORT  8080
#define TIMEOUT      1000

static struct k_sem server_sem;

static K_THREAD_STACK_DEFINE(server_stack, STACK_SIZE);

static struct k_thread server_thread;

static const unsigned char index_html_gz[] = {
#include "index.html.gz.inc"
};

static const unsigned char compressed_inc_file[] = {
	0x1f, 0x8b, 0x08, 0x00, 0x00, 0x00, 0x00, 0x00,
	0x02, 0xff, 0x35, 0x8e, 0xc1, 0x0a, 0xc2, 0x30,
	0x0c, 0x86, 0xef, 0x7d, 0x8a, 0xec, 0x05, 0x2c,
	0xbb, 0x87, 0x5c, 0x54, 0xf0, 0xe0, 0x50, 0x58,
	0x41, 0x3c, 0x4e, 0x17, 0x69, 0x21, 0xa5, 0x65,
	0x2d, 0x42, 0xdf, 0xde, 0xba, 0x6e, 0x21, 0x10,
	0xf8, 0xf9, 0xbe, 0x9f, 0x60, 0x77, 0xba, 0x1d,
	0xcd, 0xf3, 0x7e, 0x06, 0x9b, 0xbd, 0x90, 0xc2,
	0xfd, 0xf0, 0x34, 0x93, 0x82, 0x3a, 0x98, 0x5d,
	0x16, 0xa6, 0xa1, 0xc0, 0xe8, 0x7c, 0x14, 0x86,
	0x91, 0x97, 0x2f, 0x2f, 0xa8, 0x5b, 0xae, 0x50,
	0x37, 0x16, 0x5f, 0x61, 0x2e, 0x9b, 0x62, 0x7b,
	0x7a, 0xb0, 0xbc, 0x83, 0x67, 0xc8, 0x01, 0x7c,
	0x81, 0xd4, 0xd4, 0xb4, 0xaa, 0x5d, 0x55, 0xfa,
	0x8d, 0x8c, 0x64, 0xac, 0x4b, 0x50, 0x77, 0xda,
	0xa1, 0x8b, 0x19, 0xae, 0xf0, 0x71, 0xc2, 0x07,
	0xd4, 0xf1, 0xdf, 0xdf, 0x8a, 0xab, 0xb4, 0xbe,
	0xf6, 0x03, 0xea, 0x2d, 0x11, 0x5c, 0xb2, 0x00,
	0x00, 0x00,
};

static uint16_t test_http_service_port = SERVER_PORT;
HTTP_SERVICE_DEFINE(test_http_service, MY_IPV4_ADDR,
		    &test_http_service_port, 1,
		    10, NULL);

struct http_resource_detail_static index_html_gz_resource_detail = {
	.common = {
			.type = HTTP_RESOURCE_TYPE_STATIC,
			.bitmask_of_supported_http_methods = BIT(HTTP_GET),
		},
	.static_data = index_html_gz,
	.static_data_len = sizeof(index_html_gz),
};

HTTP_RESOURCE_DEFINE(index_html_gz_resource, test_http_service, "/",
		     &index_html_gz_resource_detail);

static void server_thread_fn(void *arg0, void *arg1, void *arg2)
{
	struct http_server_ctx *ctx = (struct http_server_ctx *)arg0;

	k_thread_name_set(k_current_get(), "server");

	k_sem_give(&server_sem);

	http_server_start(ctx);
}

static void test_crime(void)
{
	int ret, recv_len;
	int client_fd;
	int proto = IPPROTO_TCP;
	char *ptr;
	const char *data;
	size_t len;
	k_tid_t server_thread_id;
	struct sockaddr_in sa;
	static unsigned char buf[512];
	static struct http_server_ctx ctx;

	k_sem_init(&server_sem, 0, 1);

	ret = http_server_init(&ctx);
	zassert_equal(ret, 0, "Failed to create server socket (%d)", ret);

	server_thread_id = k_thread_create(&server_thread, server_stack,
					   K_THREAD_STACK_SIZEOF(server_stack),
					   server_thread_fn,
					   &ctx, NULL, NULL,
					   K_PRIO_PREEMPT(8), 0, K_NO_WAIT);

	ret = k_sem_take(&server_sem, K_MSEC(TIMEOUT));
	zassert_equal(0, ret, "failed to synchronize with server thread (%d)", ret);

	k_thread_name_set(k_current_get(), "client");

	ret = zsock_socket(AF_INET, SOCK_STREAM, proto);
	zassert_not_equal(ret, -1, "failed to create client socket (%d)", errno);
	client_fd = ret;

	sa.sin_family = AF_INET;
	sa.sin_port = htons(SERVER_PORT);

	ret = zsock_inet_pton(AF_INET, MY_IPV4_ADDR, &sa.sin_addr.s_addr);
	zassert_not_equal(-1, ret, "inet_pton() failed (%d)", errno);
	zassert_not_equal(0, ret, "%s is not a valid IPv4 address", MY_IPV4_ADDR);
	zassert_equal(1, ret, "inet_pton() failed to convert %s", MY_IPV4_ADDR);

	memset(buf, '\0', sizeof(buf));
	ptr = (char *)zsock_inet_ntop(AF_INET, &sa.sin_addr, buf, sizeof(buf));
	zassert_not_equal(ptr, NULL, "inet_ntop() failed (%d)", errno);

	ret = zsock_connect(client_fd, (struct sockaddr *)&sa, sizeof(sa));
	zassert_not_equal(ret, -1, "failed to connect (%s/%d)", strerror(errno), errno);

	char *http1_request = "GET / HTTP/1.1\r\n"
			      "Host: 127.0.0.1:8080\r\n"
			      "Accept: */*\r\n"
			      "Accept-Encoding: deflate, gzip, br\r\n"
			      "\r\n";

	ret = zsock_send(client_fd, http1_request, strlen(http1_request), 0);
	zassert_not_equal(ret, -1, "send() failed (%d)", errno);

	memset(buf, 0, sizeof(buf));
	recv_len = zsock_recv(client_fd, buf, sizeof(buf), 0);
	zassert_not_equal(recv_len, -1, "recv() failed (%d)", errno);

	len = sizeof(index_html_gz);

	while (recv_len < len) {
		ret = zsock_recv(client_fd, buf + recv_len, sizeof(buf) - recv_len, 0);
		zassert_not_equal(ret, -1, "recv() failed (%d)", errno);

		recv_len += ret;
	}

	data = strstr(buf, "\r\n\r\n");
	zassert_not_null(data, "Header not found");

	data += 4;

	zassert_equal(len, sizeof(compressed_inc_file), "Invalid compressed file size");

	ret = memcmp(data, compressed_inc_file, len);
	zassert_equal(ret, 0,
		      "inc_file and compressed_inc_file contents are not identical (%d)", ret);

	ret = zsock_close(client_fd);
	zassert_not_equal(-1, ret, "close() failed on the client fd (%d)", errno);

	http_server_stop(&ctx);

	ret = k_thread_join(&server_thread, K_FOREVER);
	zassert_equal(0, ret, "k_thread_join() failed (%d)", ret);

	ret = http_server_cleanup(&ctx);
	zassert_equal(ret, 0, "Failed to cleanup server (%d)", ret);
}

ZTEST(framework_tests_crime, test_gen_gz_inc_file)
{
	test_crime();
}

ZTEST_SUITE(framework_tests_crime, NULL, NULL, NULL, NULL, NULL);
```

## src/service_B.c
~~~~c
#include <limits.h>
#include <string.h>

#include <zephyr/net/http/service.h>
#include <zephyr/net/socket.h>

BUILD_ASSERT(CONFIG_TEST_SERVER_B_PORT >= 0 && CONFIG_TEST_SERVER_B_PORT <= UINT16_MAX);

/** @brief Manually define the port for HTTP service B */
#if CONFIG_TEST_SERVER_A_PORT == 0
/* An ephemeral port number is generated and written back to RAM */
#define PORTCONST
#else
/* Constant port numbers reside in ROM */
#define PORTCONST const
#endif
static PORTCONST uint16_t service_B_port = htons(CONFIG_TEST_SERVER_A_PORT);

/** @brief Manually define HTTP service B */
HTTP_SERVICE_DEFINE(service_B, CONFIG_NET_CONFIG_MY_IPV4_ADDR, &service_B_port, 1, 1, NULL);

/**
 * @brief Manually define CRiMe for index.html for service B
 *
 * This is just about as manual as we get currently. In this case, the user would have needed
 * to compress the contents of service_B/index.html offline and copy-paste it into this C file.
 *
 * E.g. the data below should match what is produced with
 * ```
 * $ gzip -9 < tests/net/lib/http_server/crime/service_B/index.html > /tmp/index.html.gz
 * $ xxd -i /tmp/index.html.gz
 * ```
 *
 * Normally, we should rely on code generation tools to do this for us, as the contents of
 * files may change from one build to the next. Here, it is only done the manual way for
 * illustrative purposes.
 */
static const uint8_t service_B_index_html_gzip_data[] = {
    0x1f, 0x8b, 0x08, 0x00, 0x00, 0x00, 0x00, 0x00,
    0x02, 0xff, 0x03, 0x00, 0x00, 0x00, 0x00, 0x00,
    0x00, 0x00, 0x00, 0x00,
};
HTTP_RESOURCE_DEFINE(service_B_index_html, service_B, "/index.html", service_B_index_html_gzip_data);

/**
 * @brief Manually define CRiMe for js/service-A.js
 *
 * This is not quite as manual as the definition of index.html above, but intentionally does not
 * use batch mode.
 *
 * The contents of the included file are generated at build time by using cmake with
 * @ref generate_inc_file_for_target. For more details, see the CMakeLists.txt in the project
 * directory.
 *
 * @note The ISO C23 standard introduces the `#embed <file.x>` directive which translates the
 * bytes of arbitrary files into C array contents.
 */
static const uint8_t service_B_js_service_B_js_gzip_data[] = {
#if defined(__STDC_VERSION__) && __STDC_VERSION__ >= 202311L
#embed "service_B/js/service-B.js"
#else 
#include "zephyr/include/generated/http_server/service_B/js/service-B.js.inc"
#endif
};
HTTP_RESOURCE_DEFINE(service_B_js_service_B_js, service_B, "/js/service-B.js", service_B_js_service_B_js_gzip_data);
~~~~
